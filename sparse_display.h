// sparse_display.h — 原版拓竹监控稀疏字体渲染（SparseGFXfont + MDI 图标 + drawSparse*）
// 从 reference/ESP32-eInk-Dashboard 原样搬运；放 src/ 独立 include；display 为 extern（主文件全局）
#pragma once
#include <Arduino.h>
#include <Adafruit_GFX.h>
#include <GxEPD2_BW.h>
#include <esp_task_wdt.h>
extern GxEPD2_BW<GxEPD2_420_Z96, GxEPD2_420_Z96::HEIGHT> display;

// 墨水屏初始化（各模块 renderFull 前调用；只真正 init 一次并置旋转，
// 后续调用仅喂狗。inline 变量为 C++17：全程序唯一实例，跨编译单元共享）
inline bool epd_inited = false;
static inline void displayInit() {
  if (!epd_inited) {
    display.init(0, 0, 10, 0);
    display.setRotation(0);
    epd_inited = true;
  }
  esp_task_wdt_reset();
}


struct SparseGFXfont {
  const uint8_t *bitmap;
  const GFXglyph *glyph;
  const uint32_t *charMap;
  uint16_t glyphCount;
  uint8_t yAdvance;
};


const uint8_t MDI_22_Sparse_Bitmaps[] PROGMEM = {
0x00,0x30,0x00,0x00,0x30,0x00,0x00,0x78,0x00,0x00,0x78,0x00,
0x00,0xFC,0x00,0x00,0xFC,0x00,0x01,0xFE,0x00,0x03,0xCF,0x00,
0x03,0xCF,0x00,0x07,0xCF,0x80,0x07,0xCF,0x80,0x0F,0xFF,0xC0,
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0xEF,0xFF,0xB0,0x0C,0x01,0x80,0x1C,0x01,0x80,0x1C,0x01,0x80,

};

const uint32_t MDI_22_Sparse_CharMap[] PROGMEM = {
0xF0026,0xF0079,0xF007A,0xF007B,0xF007C,0xF007D,0xF007E,0xF007F,0xF0080,0xF0081,0xF0082,0xF0085,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0xF1B9A,
};

const GFXglyph MDI_22_Sparse_Glyphs[] PROGMEM = {
{ 0, 22, 18, 22, 0, -17 },
{ 54, 11, 19, 22, 5, -17 },
{ 92, 11, 19, 22, 5, -17 },
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{ 2409, 21, 17, 22, 1, -16 },
};

const SparseGFXfont MDI_22_Sparse PROGMEM = {
  MDI_22_Sparse_Bitmaps,
  MDI_22_Sparse_Glyphs,
  MDI_22_Sparse_CharMap,
  53,
  22
};


// MDI 图标码（原版 configure.h）
inline constexpr uint32_t MDI_FAN_COOLING  = 0x000F1797;
inline constexpr uint32_t MDI_FAN_EXHAUST  = 0x000F0D43;
inline constexpr uint32_t MDI_FAN_AUX      = 0x000F0210;
inline constexpr uint32_t MDI_HUMIDITY     = 0x000F058E;
inline constexpr uint32_t MDI_THERMOMETER  = 0x000F050F;
inline constexpr uint32_t MDI_CLOCK        = 0x000F1452;
inline constexpr uint32_t MDI_LAYERS       = 0x000F0328;
inline constexpr uint32_t MDI_BED          = 0x000F0697;
inline constexpr uint32_t MDI_NOZZLE       = 0x000F0E5B;
inline constexpr uint32_t MDI_SPOOL        = 0x000F1294;

// ---- 原版渲染辅助（findGlyph / utf8_next / drawSparse*）----
static const GFXglyph* findGlyph(const SparseGFXfont* font, uint32_t code) {
  int low = 0;
  int high = font->glyphCount - 1;
  while (low <= high) {
    int mid = (low + high) / 2;
    uint32_t val = pgm_read_dword(&font->charMap[mid]);
    if (val == code) return &font->glyph[mid];
    if (val < code) low = mid + 1;
    else high = mid - 1;
  }
  return nullptr;
}

static uint32_t utf8_next(const char** str) {
  const unsigned char* s = (const unsigned char*)(*str);
  uint32_t codepoint = 0;
  if (*s < 0x80) {
    codepoint = *s; (*str)++;
  } else if ((*s & 0xE0) == 0xC0) {
    codepoint = s[0] & 0x1F; codepoint <<= 6; codepoint |= s[1] & 0x3F; (*str) += 2;
  } else if ((*s & 0xF0) == 0xE0) {
    codepoint = s[0] & 0x0F; codepoint <<= 6; codepoint |= s[1] & 0x3F;
    codepoint <<= 6; codepoint |= s[2] & 0x3F; (*str) += 3;
  } else if ((*s & 0xF8) == 0xF0) {
    codepoint = s[0] & 0x07; codepoint <<= 6; codepoint |= s[1] & 0x3F;
    codepoint <<= 6; codepoint |= s[2] & 0x3F; codepoint <<= 6; codepoint |= s[3] & 0x3F; (*str) += 4;
  }
  return codepoint;
}

static void drawSparseChar(const SparseGFXfont* font, int16_t x, int16_t y, uint32_t code, uint16_t color) {
  const GFXglyph* glyph = findGlyph(font, code);
  if (!glyph) return;
  uint16_t bo = pgm_read_word(&glyph->bitmapOffset);
  uint8_t w = pgm_read_byte(&glyph->width);
  uint8_t h = pgm_read_byte(&glyph->height);
  int8_t xo = pgm_read_byte(&glyph->xOffset);
  int8_t yo = pgm_read_byte(&glyph->yOffset);
  const uint8_t* bitmap = font->bitmap;
  uint8_t rowBytes = (w + 7) / 8;
  for (uint8_t yy = 0; yy < h; yy++) {
    for (uint8_t xx = 0; xx < w; xx++) {
      if (pgm_read_byte(&bitmap[bo + yy * rowBytes + xx / 8]) & (0x80 >> (xx & 7))) {
        display.drawPixel(x + xo + xx, y + yo + yy, color);
      }
    }
  }
}

// 按 glyph 实际墨迹宽高（含 xOffset/yOffset）在区域 cx..cx+regionW 内水平居中、
// 并以 cy 为垂直中心居中（不同 glyph 的 yOffset 差异会导致固定 y 不齐）
static void drawSparseCharCentered(const SparseGFXfont* font, int16_t cx, int16_t cy, uint32_t code, uint16_t color, int16_t regionW) {
  const GFXglyph* glyph = findGlyph(font, code);
  if (!glyph) return;
  uint8_t w = pgm_read_byte(&glyph->width);
  uint8_t h = pgm_read_byte(&glyph->height);
  int8_t xo = pgm_read_byte(&glyph->xOffset);
  int8_t yo = pgm_read_byte(&glyph->yOffset);
  int16_t x = cx + (regionW - w) / 2 - xo;
  int16_t y = cy - yo - h / 2;
  drawSparseChar(font, x, y, code, color);
}

// 墨迹宽度（含 xOffset 的实际占用宽）
static int16_t sparseCharWidth(const SparseGFXfont* font, uint32_t code) {
  const GFXglyph* glyph = findGlyph(font, code);
  return glyph ? pgm_read_byte(&glyph->width) : 0;
}

// 墨迹右端对齐到 R（如图标右端贴缩写左缘）
static void drawSparseCharRight(const SparseGFXfont* font, int16_t R, int16_t y, uint32_t code, uint16_t color) {
  const GFXglyph* glyph = findGlyph(font, code);
  if (!glyph) return;
  int16_t w = pgm_read_byte(&glyph->width);
  int16_t xo = pgm_read_byte(&glyph->xOffset);
  drawSparseChar(font, R - xo - w + 1, y, code, color);
}

// 墨迹左端对齐到 L
static void drawSparseCharLeft(const SparseGFXfont* font, int16_t L, int16_t y, uint32_t code, uint16_t color) {
  const GFXglyph* glyph = findGlyph(font, code);
  if (!glyph) return;
  int16_t xo = pgm_read_byte(&glyph->xOffset);
  drawSparseChar(font, L - xo, y, code, color);
}

static int16_t getSparseStringWidth(const SparseGFXfont* font, const char* str) {
  int16_t width = 0;
  const char* p = str;
  while (*p) {
    uint32_t code = utf8_next(&p);
    const GFXglyph* glyph = findGlyph(font, code);
    if (glyph) width += pgm_read_byte(&glyph->xAdvance);
    else width += font->yAdvance / 2;
  }
  return width;
}

static void drawSparseString(const SparseGFXfont* font, int16_t x, int16_t y, const char* str, uint16_t color) {
  int16_t cursorX = x;
  while (*str) {
    uint32_t code = utf8_next(&str);
    drawSparseChar(font, cursorX, y, code, color);
    const GFXglyph* glyph = findGlyph(font, code);
    if (glyph) cursorX += pgm_read_byte(&glyph->xAdvance);
    else cursorX += font->yAdvance / 2;
  }
}

static void drawSparseStringCentered(const SparseGFXfont* font, int16_t centerX, int16_t y, const char* str, uint16_t color) {
  int16_t textWidth = getSparseStringWidth(font, str);
  drawSparseString(font, centerX - (textWidth / 2), y, str, color);
}
