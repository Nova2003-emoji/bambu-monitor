// qfont24.h — QFont24 (JetBrainsMono-Medium, 1-bit, 31px) big number font.
// Extracted from projects/opencode-usage/src/qfont24q.cpp (usage-style panel font).
// Bitmaps row-packed: table[offset[i]] = char (' '+i); row stride = (width[i]+7)/8
// bytes, MSB first; bit=1 = ink pixel. Height = 31.
#pragma once
#include <Arduino.h>

typedef struct {
  const uint8_t *table;
  const uint8_t *width;    // [95] advance width of char (' '+i)
  const uint16_t *offset;  // [96] byte index; [95]=total bytes
  uint16_t Height;
} QFONT;

const uint8_t Font24_Table[] = {
  0x00, 0x00, 0x00, 0x00, 0x00, 0x00, 0x00, 0x00, 0x00, 0x00, 0x00, 0x00, 0x00, 0x00, 0x00, 0x00,
  0x00, 0x00, 0x00, 0x00, 0x00, 0x00, 0x00, 0x00, 0x00, 0x00, 0x00, 0x00, 0x00, 0x00, 0x00, 0x00,
  0x00, 0x00, 0x00, 0x00, 0x00, 0x00, 0x00, 0x00, 0x00, 0x00, 0x00, 0x00, 0x00, 0x00, 0x00, 0x00,
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  0x00, 0x00,
};

const uint8_t Font24_Width[] = {
  0x0D, 0x0D, 0x0D, 0x0D, 0x0D, 0x0D, 0x0D, 0x0D, 0x0D, 0x0D, 0x0D, 0x0D, 0x0D, 0x0D, 0x0D, 0x0D,
  0x0D, 0x0D, 0x0D, 0x0D, 0x0D, 0x0D, 0x0D, 0x0D, 0x0D, 0x0D, 0x0D, 0x0D, 0x0D, 0x0D, 0x0D, 0x0D,
  0x0D, 0x0D, 0x0D, 0x0D, 0x0D, 0x0D, 0x0D, 0x0D, 0x0D, 0x0D, 0x0D, 0x0D, 0x0D, 0x0D, 0x0D, 0x0D,
  0x0D, 0x0D, 0x0D, 0x0D, 0x0D, 0x0D, 0x0D, 0x0D, 0x0D, 0x0D, 0x0D, 0x0D, 0x0D, 0x0D, 0x0D, 0x0D,
  0x0D, 0x0D, 0x0D, 0x0D, 0x0D, 0x0D, 0x0D, 0x0D, 0x0D, 0x0D, 0x0D, 0x0D, 0x0D, 0x0D, 0x0D, 0x0D,
  0x0D, 0x0D, 0x0D, 0x0D, 0x0D, 0x0D, 0x0D, 0x0D, 0x0D, 0x0D, 0x0D, 0x0D, 0x0D, 0x0D, 0x0D,
};

const uint16_t Font24_Offset[] = {
  0, 62, 124, 186, 248, 310, 372, 434, 496, 558, 620, 682, 744, 806, 868, 930,
  992, 1054, 1116, 1178, 1240, 1302, 1364, 1426, 1488, 1550, 1612, 1674, 1736, 1798, 1860, 1922,
  1984, 2046, 2108, 2170, 2232, 2294, 2356, 2418, 2480, 2542, 2604, 2666, 2728, 2790, 2852, 2914,
  2976, 3038, 3100, 3162, 3224, 3286, 3348, 3410, 3472, 3534, 3596, 3658, 3720, 3782, 3844, 3906,
  3968, 4030, 4092, 4154, 4216, 4278, 4340, 4402, 4464, 4526, 4588, 4650, 4712, 4774, 4836, 4898,
  4960, 5022, 5084, 5146, 5208, 5270, 5332, 5394, 5456, 5518, 5580, 5642, 5704, 5766, 5828, 5890,
};


const QFONT QFont24 = { Font24_Table, Font24_Width, Font24_Offset, 31 /* Height */ };

// advance width (px) of a string in this font（与 drawQFontString 的 °C 连体一致）
static int16_t qfontWidth(const QFONT* f, const char* s) {
  int16_t w = 0;
  while (*s) {
    unsigned char c = (unsigned char)*s;
    if (c == 0xC2) { s++; continue; }              // UTF-8 前缀跳过
    if (c == 0xB0) {                                // °C 连体：° 圆 4px + C 宽
      w += 4; s++;
      if (*s == 'C' || *s == 'c') { w += f->width[*s - 0x20]; s++; }
      continue;
    }
    if (c >= 0x20 && c <= 0x7E) w += f->width[c - 0x20];
    else w += 1;
    s++;
  }
  return w;
}

// draw with display.drawPixel (GxEPD2/Adafruit frame buffer); bit=1 = ink.
// UTF-8 "°" (0xC2 0xB0) is drawn as a small ring (degree symbol, no glyph in font).
static void drawQFontString(int16_t x, int16_t y, const QFONT* f, const char* s, uint16_t ink) {
  while (*s) {
    unsigned char c = (unsigned char)*s;
    if (c == 0xC2) { s++; continue; }              // UTF-8 双字节前缀（跳过）
    if (c == 0xB0) {                                // °C 连体符号：° 圆（上标）+ C 整体渲染
      display.drawCircle(x + 2, y + 7, 1, ink);     // ° 圆
      display.drawPixel(x + 1, y + 6, ink);         // 四角补点
      display.drawPixel(x + 3, y + 6, ink);
      display.drawPixel(x + 1, y + 8, ink);
      display.drawPixel(x + 3, y + 8, ink);
      x += 4;
      s++;
      if (*s == 'C' || *s == 'c') {                 // 后跟 C → 组合 °C（C 在 ° 右下方）
        uint16_t iC = (*s - 0x20), wC = f->width[iC], offC = f->offset[iC];
        uint16_t wbC = (wC + 7) / 8;
        const uint8_t* pC = &f->table[offC];
        for (uint16_t r = 0; r < f->Height; r++)
          for (uint16_t c2 = 0; c2 < wC; c2++)
            if (pC[r * wbC + c2 / 8] & (0x80 >> (c2 % 8)))
              display.drawPixel(x + c2, y + r, ink);
        x += wC;
        s++;
      }
      continue;
    }
    if (c < 0x20 || c > 0x7E) { x += 1; s++; continue; }
    uint16_t idx = c - 0x20;
    uint16_t w = f->width[idx];
    uint16_t off = f->offset[idx];
    uint16_t wb = (w + 7) / 8;
    const uint8_t* ptr = &f->table[off];
    for (uint16_t row = 0; row < f->Height; row++) {
      for (uint16_t col = 0; col < w; col++) {
        if (ptr[row * wb + col / 8] & (0x80 >> (col % 8)))
          display.drawPixel(x + col, y + row, ink);
      }
    }
    x += w;
    s++;
  }
}
